## config/boards/shields/moNa2/Kconfig
```kconfig
if SHIELD_MoNa2_R || SHIELD_MoNa2_L

config ZMK_RGBLED_WIDGET_COMPAT
    bool "Enable RGBLED widget endpoint compatibility shims"
    default y

endif
```

## config/boards/shields/moNa2/Kconfig.defconfig
```kconfig
if SHIELD_MoNa2_R || SHIELD_MoNa2_L

config ZMK_RGBLED_WIDGET_COMPAT
    bool "Enable RGBLED widget endpoint compatibility shims"
    default y

endif

if SHIELD_MONA2_R

config ZMK_KEYBOARD_NAME
    default "moNa2_R"

config ZMK_SPLIT
    default y

config ZMK_SPLIT_ROLE_CENTRAL
    default y

endif

if SHIELD_MONA2_L

config ZMK_KEYBOARD_NAME
    default "moNa2_L"

config ZMK_SPLIT
    default y

endif
```

## config/west.yml
```yaml
manifest:
  defaults:
    revision: main
  remotes:
    - name: zmkfirmware
      url-base: https://github.com/zmkfirmware
    - name: sayu-hub
      url-base: https://github.com/sayu-hub
    - name: caksoylar
      url-base: https://github.com/caksoylar
    - name: cormoran
      url-base: https://github.com/cormoran
  projects:
    - name: zmk
      remote: cormoran
      revision: v0.3-branch+dya
      import: app/west.yml
    - name: zmk-pmw3610-driver
      remote: sayu-hub
      revision: main
    - name: zmk-rgbled-widget
      remote: caksoylar
      revision: main
    - name: zmk-module-ble-management
      remote: cormoran
      revision: main
    - name: zmk-module-battery-history
      remote: cormoran
      revision: main
    - name: zmk-module-settings-rpc
      remote: cormoran
      revision: main
    - name: zmk-module-runtime-input-processor
      remote: cormoran
      revision: main
  self:
    path: config
```
